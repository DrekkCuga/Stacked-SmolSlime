## i2c/Drekk-Stacked-SmolSlime/Kconfig/Kconfig.shield
```kconfig
osource "/home/drekk/Documents/Code/VR-Trackers/Drekk-Stacked-SmolSlime/boards/shields/*/Kconfig.shield"
osource "/home/drekk/Documents/Code/VR-Trackers/nrf/boards/shields/*/Kconfig.shield"
```

## i2c/Drekk-Stacked-SmolSlime/Kconfig/Kconfig.shield.defconfig
```kconfig
osource "/home/drekk/Documents/Code/VR-Trackers/Drekk-Stacked-SmolSlime/boards/shields/*/Kconfig.defconfig"
osource "/home/drekk/Documents/Code/VR-Trackers/nrf/boards/shields/*/Kconfig.defconfig"
```

## i2c/Drekk-Stacked-SmolSlime/Kconfig/arch/Kconfig
```kconfig
# Load Zephyr Arch Kconfig descriptions.
osource "/home/drekk/Documents/Code/VR-Trackers/zephyr/arch/rx/Kconfig"
osource "/home/drekk/Documents/Code/VR-Trackers/zephyr/arch/x86/Kconfig"
osource "/home/drekk/Documents/Code/VR-Trackers/zephyr/arch/xtensa/Kconfig"
osource "/home/drekk/Documents/Code/VR-Trackers/zephyr/arch/sparc/Kconfig"
osource "/home/drekk/Documents/Code/VR-Trackers/zephyr/arch/riscv/Kconfig"
osource "/home/drekk/Documents/Code/VR-Trackers/zephyr/arch/posix/Kconfig"
osource "/home/drekk/Documents/Code/VR-Trackers/zephyr/arch/mips/Kconfig"
osource "/home/drekk/Documents/Code/VR-Trackers/zephyr/arch/arm64/Kconfig"
osource "/home/drekk/Documents/Code/VR-Trackers/zephyr/arch/arm/Kconfig"
osource "/home/drekk/Documents/Code/VR-Trackers/zephyr/arch/arc/Kconfig"
```

## i2c/Drekk-Stacked-SmolSlime/Kconfig/boards/Kconfig.defconfig
```kconfig
# Load Zephyr board defconfig descriptions.
osource "/home/drekk/Documents/Code/VR-Trackers/Drekk-Stacked-SmolSlime/boards/nordic/promicro_uf2/Kconfig.defconfig"
```

## i2c/Drekk-Stacked-SmolSlime/Kconfig/boards/Kconfig.promicro_uf2
```kconfig
# Load board Kconfig descriptions.
osource "/home/drekk/Documents/Code/VR-Trackers/Drekk-Stacked-SmolSlime/boards/nordic/promicro_uf2/Kconfig.promicro_uf2"
```

## i2c/Drekk-Stacked-SmolSlime/Kconfig/soc/Kconfig
```kconfig
# Load Zephyr SoC Kconfig descriptions.
osource "/home/drekk/Documents/Code/VR-Trackers/zephyr/soc/xlnx/zynqmp/Kconfig"
osource "/home/drekk/Documents/Code/VR-Trackers/zephyr/soc/xlnx/zynq7000/Kconfig"
osource "/home/drekk/Documents/Code/VR-Trackers/zephyr/soc/xlnx/versalnet/Kconfig"
osource "/home/drekk/Documents/Code/VR-Trackers/zephyr/soc/xlnx/versal2/Kconfig"
osource "/home/drekk/Documents/Code/VR-Trackers/zephyr/soc/xen/Kconfig"
osource "/home/drekk/Documents/Code/VR-Trackers/zephyr/soc/wch/ch32v/Kconfig"
osource "/home/drekk/Documents/Code/VR-Trackers/zephyr/soc/ti/simplelink/Kconfig"
osource "/home/drekk/Documents/Code/VR-Trackers/zephyr/soc/ti/mspm0/Kconfig"
osource "/home/drekk/Documents/Code/VR-Trackers/zephyr/soc/ti/lm3s6965/Kconfig"
osource "/home/drekk/Documents/Code/VR-Trackers/zephyr/soc/ti/k3/Kconfig"
osource "/home/drekk/Documents/Code/VR-Trackers/zephyr/soc/telink/tlsr/Kconfig"
osource "/home/drekk/Documents/Code/VR-Trackers/zephyr/soc/starfive/jh71xx/Kconfig"
osource "/home/drekk/Documents/Code/VR-Trackers/zephyr/soc/st/stm32/Kconfig"
osource "/home/drekk/Documents/Code/VR-Trackers/zephyr/soc/snps/qemu_arc/Kconfig"
osource "/home/drekk/Documents/Code/VR-Trackers/zephyr/soc/snps/nsim/arc_v/Kconfig"
osource "/home/drekk/Documents/Code/VR-Trackers/zephyr/soc/snps/nsim/arc_classic/Kconfig"
osource "/home/drekk/Documents/Code/VR-Trackers/zephyr/soc/snps/hsdk4xd/Kconfig"
osource "/home/drekk/Documents/Code/VR-Trackers/zephyr/soc/snps/hsdk/Kconfig"
osource "/home/drekk/Documents/Code/VR-Trackers/zephyr/soc/snps/emsk/Kconfig"
osource "/home/drekk/Documents/Code/VR-Trackers/zephyr/soc/snps/emsdp/Kconfig"
osource "/home/drekk/Documents/Code/VR-Trackers/zephyr/soc/snps/arc_iot/Kconfig"
osource "/home/drekk/Documents/Code/VR-Trackers/zephyr/soc/silabs/Kconfig"
osource "/home/drekk/Documents/Code/VR-Trackers/zephyr/soc/sifive/sifive_freedom/Kconfig"
osource "/home/drekk/Documents/Code/VR-Trackers/zephyr/soc/sensry/Kconfig"
osource "/home/drekk/Documents/Code/VR-Trackers/zephyr/soc/rockchip/Kconfig"
osource "/home/drekk/Documents/Code/VR-Trackers/zephyr/soc/renode/riscv_virtual/Kconfig"
osource "/home/drekk/Documents/Code/VR-Trackers/zephyr/soc/renode/cortex_r8_virtual/Kconfig"
osource "/home/drekk/Documents/Code/VR-Trackers/zephyr/soc/renesas/smartbond/Kconfig"
osource "/home/drekk/Documents/Code/VR-Trackers/zephyr/soc/renesas/rz/Kconfig"
osource "/home/drekk/Documents/Code/VR-Trackers/zephyr/soc/renesas/rx/Kconfig"
osource "/home/drekk/Documents/Code/VR-Trackers/zephyr/soc/renesas/rcar/Kconfig"
osource "/home/drekk/Documents/Code/VR-Trackers/zephyr/soc/renesas/ra/Kconfig"
osource "/home/drekk/Documents/Code/VR-Trackers/zephyr/soc/realtek/ec/Kconfig"
osource "/home/drekk/Documents/Code/VR-Trackers/zephyr/soc/raspberrypi/rpi_pico/Kconfig"
osource "/home/drekk/Documents/Code/VR-Trackers/zephyr/soc/quicklogic/eos_s3/Kconfig"
osource "/home/drekk/Documents/Code/VR-Trackers/zephyr/soc/qemu/virt_riscv/Kconfig"
osource "/home/drekk/Documents/Code/VR-Trackers/zephyr/soc/qemu/malta/Kconfig"
osource "/home/drekk/Documents/Code/VR-Trackers/zephyr/soc/openisa/rv32m1/Kconfig"
osource "/home/drekk/Documents/Code/VR-Trackers/zephyr/soc/openhwgroup/cva6/Kconfig"
osource "/home/drekk/Documents/Code/VR-Trackers/zephyr/soc/oct/osd32mp15x/Kconfig"
osource "/home/drekk/Documents/Code/VR-Trackers/zephyr/soc/nxp/s32/Kconfig"
osource "/home/drekk/Documents/Code/VR-Trackers/zephyr/soc/nxp/rw/Kconfig"
osource "/home/drekk/Documents/Code/VR-Trackers/zephyr/soc/nxp/mcx/Kconfig"
osource "/home/drekk/Documents/Code/VR-Trackers/zephyr/soc/nxp/lpc/Kconfig"
osource "/home/drekk/Documents/Code/VR-Trackers/zephyr/soc/nxp/layerscape/Kconfig"
osource "/home/drekk/Documents/Code/VR-Trackers/zephyr/soc/nxp/kinetis/Kconfig"
osource "/home/drekk/Documents/Code/VR-Trackers/zephyr/soc/nxp/imxrt/Kconfig"
osource "/home/drekk/Documents/Code/VR-Trackers/zephyr/soc/nxp/imx/Kconfig"
osource "/home/drekk/Documents/Code/VR-Trackers/zephyr/soc/nuvoton/numicro/Kconfig"
osource "/home/drekk/Documents/Code/VR-Trackers/zephyr/soc/nuvoton/numaker/Kconfig"
osource "/home/drekk/Documents/Code/VR-Trackers/zephyr/soc/nuvoton/npcx/Kconfig"
osource "/home/drekk/Documents/Code/VR-Trackers/zephyr/soc/nuvoton/npcm/Kconfig"
osource "/home/drekk/Documents/Code/VR-Trackers/zephyr/soc/nordic/Kconfig"
osource "/home/drekk/Documents/Code/VR-Trackers/zephyr/soc/neorv32/Kconfig"
osource "/home/drekk/Documents/Code/VR-Trackers/zephyr/soc/native/inf_clock/Kconfig"
osource "/home/drekk/Documents/Code/VR-Trackers/zephyr/soc/microchip/sam/Kconfig"
osource "/home/drekk/Documents/Code/VR-Trackers/zephyr/soc/microchip/miv/Kconfig"
osource "/home/drekk/Documents/Code/VR-Trackers/zephyr/soc/microchip/mec/Kconfig"
osource "/home/drekk/Documents/Code/VR-Trackers/zephyr/soc/mediatek/mt8xxx/Kconfig"
osource "/home/drekk/Documents/Code/VR-Trackers/zephyr/soc/lowrisc/opentitan/Kconfig"
osource "/home/drekk/Documents/Code/VR-Trackers/zephyr/soc/litex/litex_vexriscv/Kconfig"
osource "/home/drekk/Documents/Code/VR-Trackers/zephyr/soc/ite/ec/Kconfig"
osource "/home/drekk/Documents/Code/VR-Trackers/zephyr/soc/intel/raptor_lake/Kconfig"
osource "/home/drekk/Documents/Code/VR-Trackers/zephyr/soc/intel/lakemont/Kconfig"
osource "/home/drekk/Documents/Code/VR-Trackers/zephyr/soc/intel/intel_socfpga_std/Kconfig"
osource "/home/drekk/Documents/Code/VR-Trackers/zephyr/soc/intel/intel_socfpga/Kconfig"
osource "/home/drekk/Documents/Code/VR-Trackers/zephyr/soc/intel/intel_niosv/Kconfig"
osource "/home/drekk/Documents/Code/VR-Trackers/zephyr/soc/intel/intel_ish/Kconfig"
osource "/home/drekk/Documents/Code/VR-Trackers/zephyr/soc/intel/intel_adsp/Kconfig"
osource "/home/drekk/Documents/Code/VR-Trackers/zephyr/soc/intel/elkhart_lake/Kconfig"
osource "/home/drekk/Documents/Code/VR-Trackers/zephyr/soc/intel/atom/Kconfig"
osource "/home/drekk/Documents/Code/VR-Trackers/zephyr/soc/intel/apollo_lake/Kconfig"
osource "/home/drekk/Documents/Code/VR-Trackers/zephyr/soc/intel/alder_lake/Kconfig"
osource "/home/drekk/Documents/Code/VR-Trackers/zephyr/soc/infineon/cat3/Kconfig"
osource "/home/drekk/Documents/Code/VR-Trackers/zephyr/soc/infineon/cat1c/Kconfig"
osource "/home/drekk/Documents/Code/VR-Trackers/zephyr/soc/infineon/cat1b/Kconfig"
osource "/home/drekk/Documents/Code/VR-Trackers/zephyr/soc/infineon/cat1a/Kconfig"
osource "/home/drekk/Documents/Code/VR-Trackers/zephyr/soc/gd/gd32/Kconfig"
osource "/home/drekk/Documents/Code/VR-Trackers/zephyr/soc/gaisler/leon3/Kconfig"
osource "/home/drekk/Documents/Code/VR-Trackers/zephyr/soc/gaisler/gr716a/Kconfig"
osource "/home/drekk/Documents/Code/VR-Trackers/zephyr/soc/espressif/Kconfig"
osource "/home/drekk/Documents/Code/VR-Trackers/zephyr/soc/ene/kb1200/Kconfig"
osource "/home/drekk/Documents/Code/VR-Trackers/zephyr/soc/efinix/sapphire/Kconfig"
osource "/home/drekk/Documents/Code/VR-Trackers/zephyr/soc/cdns/xtensa_sample_controller/Kconfig"
osource "/home/drekk/Documents/Code/VR-Trackers/zephyr/soc/cdns/sample_controller32/Kconfig"
osource "/home/drekk/Documents/Code/VR-Trackers/zephyr/soc/cdns/dc233c/Kconfig"
osource "/home/drekk/Documents/Code/VR-Trackers/zephyr/soc/brcm/bcmvk/Kconfig"
osource "/home/drekk/Documents/Code/VR-Trackers/zephyr/soc/brcm/bcm2712/Kconfig"
osource "/home/drekk/Documents/Code/VR-Trackers/zephyr/soc/brcm/bcm2711/Kconfig"
osource "/home/drekk/Documents/Code/VR-Trackers/zephyr/soc/bflb/Kconfig"
osource "/home/drekk/Documents/Code/VR-Trackers/zephyr/soc/atmel/sam0/Kconfig"
osource "/home/drekk/Documents/Code/VR-Trackers/zephyr/soc/atmel/sam/Kconfig"
osource "/home/drekk/Documents/Code/VR-Trackers/zephyr/soc/aspeed/Kconfig"
osource "/home/drekk/Documents/Code/VR-Trackers/zephyr/soc/arm/Kconfig"
osource "/home/drekk/Documents/Code/VR-Trackers/zephyr/soc/arm/beetle/Kconfig"
osource "/home/drekk/Documents/Code/VR-Trackers/zephyr/soc/antmicro/myra/Kconfig"
osource "/home/drekk/Documents/Code/VR-Trackers/zephyr/soc/andestech/Kconfig"
osource "/home/drekk/Documents/Code/VR-Trackers/zephyr/soc/amd/acp_6_0/Kconfig"
osource "/home/drekk/Documents/Code/VR-Trackers/zephyr/soc/ambiq/Kconfig"
osource "/home/drekk/Documents/Code/VR-Trackers/zephyr/soc/aesc/Kconfig"
osource "/home/drekk/Documents/Code/VR-Trackers/zephyr/soc/adi/max32/Kconfig"
osource "/home/drekk/Documents/Code/VR-Trackers/nrf/soc/sercomm/nrf91/Kconfig"
osource "/home/drekk/Documents/Code/VR-Trackers/nrf/soc/nordic/Kconfig"
```
